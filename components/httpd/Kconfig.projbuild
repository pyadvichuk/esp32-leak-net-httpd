## components/httpd/Kconfig.projbuild
```kconfig
menu "HTTPD"
    config WBOX_HTTPD_TRANSPORT_SSL
        bool "Enable SSL encryption"
        default n
        select ESP_HTTPS_SERVER_ENABLE
        select ESP_TLS_SERVER
        help
            This option enables encryption for http daemon.

    config WBOX_HTTPD_MAX_CONNECTION
        int "Maximum parallel connections"
        default 4
        help
            Maximum parallel connections

    config WBOX_HTTPD_CONNECTION_EXPIRE
        int "Time to connection expiration in seconds"
        default 300
        help
            Time to  connection expiration in seconds

endmenu
```

## components/transport/Kconfig.projbuild
```kconfig
menu "Wallbox transpoort config"

    config WIFI_STA_SSID
        string "Router WiFi SSID"
        default "myssid"
        help
            SSID (network name) for the example to connect to.

    config WIFI_STA_PASSWORD
        string "Router WiFi password"
        default "mypassword"
        help
            WiFi password (WPA or WPA2) for the example to use.
            Can be left blank if the network has no security set.

    config WIFI_AP_PASSWORD
        string "Access point WiFi password"
        default "mypassword"
        help
            WiFi password (WPA or WPA2) for the example to use.
            Can be left blank if the network has no security set.

    config WIFI_AP_MAX_CONNECTIONS
        int "Maximal STA connections"
        default 4
        help
            Max number of the STA connects to AP.

    choice WBOX_USE_ETHERNET
        prompt "Ethernet Type"
        default WBOX_USE_INTERNAL_ETHERNET
        help
            Select which kind of Ethernet will be used in the example.

        config WBOX_USE_INTERNAL_ETHERNET
            depends on IDF_TARGET_ESP32
            select ETH_USE_ESP32_EMAC
            bool "Internal EMAC"
            help
                Select internal Ethernet MAC controller.
    endchoice

    if WBOX_USE_INTERNAL_ETHERNET
        choice WBOX_ETH_PHY_MODEL
            prompt "Ethernet PHY Device"
            default WBOX_ETH_PHY_KSZ8081
            help
                Select the Ethernet PHY device to use in the example.

            config WBOX_ETH_PHY_KSZ8081
                bool "KSZ8081"
                help
                    Single-chip 10Base-T/100Base-TX IEEE 802.3 compliant Ethernet transceiver.
                    Goto https://www.microchip.com/wwwproducts/en/KSZ8081 for more information about it.
        endchoice

        config WBOX_ETH_MDC_GPIO
            int "SMI MDC GPIO number"
            default 23
            help
                Set the GPIO number used by SMI MDC.

        config WBOX_ETH_MDIO_GPIO
            int "SMI MDIO GPIO number"
            default 18
            help
                Set the GPIO number used by SMI MDIO.
    endif

    config WBOX_ETH_PHY_RST_GPIO
        int "PHY Reset GPIO number"
        default 5
        help
            Set the GPIO number used to reset PHY chip.
            Set to -1 to disable PHY chip hardware reset.

    config WBOX_ETH_PHY_ADDR
        int "PHY Address"
        range 0 31 if WBOX_USE_INTERNAL_ETHERNET
        range 1 1 if !WBOX_USE_INTERNAL_ETHERNET
        default 1
        help
            Set PHY address according your board schematic.

endmenu
```
